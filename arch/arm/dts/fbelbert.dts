/dts-v1/;

#include "ast2500-fboss.dtsi"
/ {
	aliases {
		ethernet0 = &mac0;
	};
};


&mac0 {
	status = "okay";
	phy-mode = "rgmii";

	pinctrl-names = "default";
	pinctrl-0 = <&pinctrl_mac1link_default &pinctrl_mdio1_default>;

        fixed-link {
           speed = <100>;
           full-duplex;
        };
};


