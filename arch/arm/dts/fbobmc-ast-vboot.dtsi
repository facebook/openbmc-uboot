// SPDX-License-Identifier: GPL-2.0+
/*
 * Copyright (c) 2020 Facebook Inc.
 */

/ {
	config {
		/* short term solution not enable bootsecure option,
		 * hardcode the bootcmd list in fdt, which will be verfied by SPL.
		 * long term shall enable bootsecure option and
		 * have vbs command to implement all verified-boot
		 */
		bootsecure = <0>;
#ifdef CONFIG_ASPEED_RECOVERY_BUILD
		bootcmd = "setenv verify no; bootm 201A0000";
#else
		bootcmd = "vbs oscheck; bootm 281A0000; vbs 6 60; setenv verify no; bootm 201A0000";
#endif
	};

	aliases {
		spi0 = &fmc;
	};
};

#ifdef CONFIG_GIU_HW_SUPPORT
#include <dt-bindings/gpio/aspeed-gpio.h>
/ {
		bsm_wp_latch {
			u-boot,dm-pre-reloc;
			compatible = "bsm_wp_latch";
			/* latch_ctrl is reverted logic so set GPIO_ACTIVE_LOW flag
			*  u-boot GPIO DM driver is expecting logic active or deactive
			*  and based on this flag to properly output physical high
			*  or low signal to the pin. Refer to dm_gpio_set/get_value()
			*/
			latch_ctrl-gpios = <&gpio0 ASPEED_GPIO(Y, 2) GPIO_ACTIVE_LOW>;
			latch_status-gpios = <&gpio0 ASPEED_GPIO(I, 5) GPIO_ACTIVE_HIGH>;
			};
};
#endif
