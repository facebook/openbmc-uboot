/dts-v1/;

#include "ast2500-fboss.dtsi"
/ {
	aliases {
		eth0 = &mac0;
		eth1 = &mac1;
	};
};

&mac1 {
	status = "okay";

	phy-mode = "NC-SI";
	use-ncsi;
	pinctrl-names = "default";
	pinctrl-0 = <&pinctrl_mac2link_default>;
};
