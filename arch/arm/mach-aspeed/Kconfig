## board/fb-obmc/Kconfig
```kconfig
config ASPEED_TPM
	bool "TPM based feature"
	default n
	select TPM
	depends on SPL
	help
		Enable TPM based feature:
		measurement and rollback protection

config ASPEED_TPM_LOCK
	bool "lock the TPM"
	default y
	depends on ASPEED_TPM
	help
		Disable the modify of NVRAM to protect user from modifying
		the rollback protection information
		TPM1.2 platform disable physical presence command
		TPM2.0 platform disable the platform hierarchy

config ASPEED_RECOVERY_BUILD
	bool "Build a recovery environment"
	default n
	depends on SPL

config PFR_SUPPORT
	bool "support Intel FPR"
	default n

config FBOBMC_IMG_LAYOUT_VER
	int "fb-obmc image layout version"
	default 0
	range 0 1

config ASPEED_WRITE_DEFAULT_ENV
	bool "Enable write default environment"
	default n

config QEMU_BUILD
	bool "build for QEMU test"
	default n

config QEMU_VBOOT
	bool "build for QEMU VBoot test machine"
	select QEMU_BUILD
	default n

config ASPEED_ENABLE_DUAL_BOOT_WATCHDOG
	bool "enable dual boot feature"
	default n
	help
		Enable this will override CONFIG_ASPEED_ENABLE_WATCHDOG
		use dual boot dedicated watchdog to protect booting up
		on AST26xx platform it is FMCWDT2
		on AST24xx and AST25xx platform we select wdt2
		so please make sure configuring wdt2 with boot2nd in dts
		&wdt2 {
			status = "okay";
			boot2nd = <1>;
		};

config GIU_HW_SUPPORT
	bool "With SPI Flash WP# control LATCH circuit"
	default n
	help
		To support secure upgrading the Golden Image of verified boot
		some platforms introduce a D-State flipflop based latch circuit
		to allow ONLY verified boot CRTM (SPL) control the flash WP#

config GIU_HW_OPEN
	bool "Keep the SPI Flash WP# control LATCH in open state"
	default n
	depends on GIU_HW_SUPPORT
	help
		Used for developing time keep the WP# control latch opened,
		thus the user space code can decide whether latch the WP# to low
		or keep it in high (inactivate), thus Golden Image can be upgraded

config FBVBOOT_GOLDEN_IMAGE_SIZE_MB
	int "FB verified boot golden image size, support value (32 or 64) MB"
	default 32
	help
		Define the size in SPI0 CE0 flash reserved to contain the
		manufacturing default image (a.k.a golden image).
		FB verified boot will write protect SPI0 CE0 (spi0.0) range
		[0, FBVBOOT_GOLDEN_IMAGE_SIZE_MB) to make golden image immutable

if SPL

config SYS_TEXT_BASE
	depends on !QEMU_VBOOT && (TARGET_FB_AST_GEN_5 || TARGET_FB_AST_GEN_6)
	default 0x20015000 if ASPEED_RECOVERY_BUILD && (FBOBMC_IMG_LAYOUT_VER = 0)
	default 0x28084000 if !ASPEED_RECOVERY_BUILD && (FBOBMC_IMG_LAYOUT_VER = 0)
	default 0x20040000 if ASPEED_RECOVERY_BUILD && (FBOBMC_IMG_LAYOUT_VER = 1)
	default 0x28104000 if !ASPEED_RECOVERY_BUILD && (FBOBMC_IMG_LAYOUT_VER = 1)

config SYS_TEXT_BASE
	depends on QEMU_VBOOT && (TARGET_FB_AST_GEN_5 || TARGET_FB_AST_GEN_6)
	default 0x40015000 if ASPEED_RECOVERY_BUILD && (FBOBMC_IMG_LAYOUT_VER = 0)
	default 0x48084000 if !ASPEED_RECOVERY_BUILD && (FBOBMC_IMG_LAYOUT_VER = 0)
	default 0x40040000 if ASPEED_RECOVERY_BUILD && (FBOBMC_IMG_LAYOUT_VER = 1)
	default 0x48104000 if !ASPEED_RECOVERY_BUILD && (FBOBMC_IMG_LAYOUT_VER = 1)

endif

source "board/fb-obmc/ast/Kconfig"
```
