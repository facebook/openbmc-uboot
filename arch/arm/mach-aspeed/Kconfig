## arch/arm/mach-aspeed/Kconfig
```kconfig
if ARCH_ASPEED

config SYS_ARCH
	default "arm"

config SYS_SOC
	default "aspeed"

config SYS_TEXT_BASE
	default 0x00000000 if !SPL

choice
	prompt "Aspeed SoC select"
	depends on ARCH_ASPEED
	default ASPEED_AST2500

config ASPEED_AST2400
        bool "Support Aspeed AST2400 SoC"
        select CPU_ARM926EJS
        help
          The Aspeed AST2400 is a ARM-based SoC with arm926ejs CPU.
          It is used as Board Management Controller on many server boards,
          which is enabled by support of LPC and eSPI peripherals.

config ASPEED_AST2500
	bool "Support Aspeed AST2500 SoC"
	select CPU_ARM1176
	select SUPPORT_SPL
	help
	  The Aspeed AST2500 is a ARM-based SoC with arm1176 CPU.
	  It is used as Board Management Controller on many server boards,
	  which is enabled by support of LPC and eSPI peripherals.

config ASPEED_AST2600
	bool "Support Aspeed AST2600 SoC"
	select CPU_V7A
	select CPU_V7_HAS_NONSEC
	select ARCH_SUPPORT_PSCI
	select SYS_ARCH_TIMER
	select SUPPORT_SPL
	select ENABLE_ARM_SOC_BOOT0_HOOK
	help
	  The Aspeed AST2600 is a ARM-based SoC with Cortex-A7 CPU.
	  It is used as Board Management Controller on many server boards,
	  which is enabled by support of LPC and eSPI peripherals.
endchoice

config ASPEED_GEN_5
	bool "ASPEED G5 platform"

config ARCH_AST2500
	bool "TEMP used to migrate from ASPEED AST2500 SDK to upstream"

config ASPEED_PALLADIUM
	bool "Aspeed palladium for simulation"
	default n
	help
	  Say Y here to enable palladium build for simulation.

	  This is mainly for internal verification and investigation
	  on HW design. If not sure, say N.

config ASPEED_SSP_RERV_MEM
	hex "Reserve memory for SSP"
	default 0x0
	help
	  The size in bytes of reserve memory for ASPEED SoC SSP run.

config ASPEED_SECURE_BOOT
	bool "Support Aspeed secure boot feature"
	depends on SPL && ASPEED_AST2600
	select ENABLE_ARM_SOC_BOOT0_HOOK
	select CMD_BOOTS
	help
	  This option enables the support for secure boot.

config ASPEED_SECURE_BOOT_DEBUG
	bool "Enable debug support with secure boot"
	default y
	depends on ASPEED_SECURE_BOOT
	help
	  This option allows the bootm command use

config ASPEED_LOADERS
	bool "Aspeed custom loaders"
	depends on SPL
	default y
	help
	  Enable the custom payload loading methods used by ASPEED. This is requited to
	  use ASPEED's proprietary secure boot feature.

if ASPEED_LOADERS

config ASPEED_UBOOT_MMC_PART
	int "U-Boot eMMC partition"
	default 0
	help
	  The partition number of the U-Boot
	  image in the eMMC device. This is not
	  the user data partition number.

config ASPEED_UBOOT_SPI_BASE
	hex "U-Boot SPI base address"
	default 0x0
	help
	  The base address of the U-Boot image in
	  the memory mapped SPI space

config ASPEED_UBOOT_SPI_SIZE
	hex "U-Boot SPI size in bytes"
	default 0x0
	help
	  The size in bytes of the U-Boot image in
	  the memory mapped SPI space

config ASPEED_UBOOT_MMC_BASE
	hex "U-Boot eMMC base block"
	default 0x0
	help
	  The base block number of the U-Boot
	  image in the eMMC device

config ASPEED_UBOOT_MMC_SIZE
	hex "U-Boot eMMC size in blocks"
	default 0x0
	help
	  The size in block count of the U-Boot
	  image in the eMMC device

config ASPEED_UBOOT_UART_SIZE
	hex "U-Boot UART size in bytes"
	default 0x0
	help
	  The size of U-Boot image to be recevied
	  from UART device

config ASPEED_UBOOT_DRAM_BASE
	hex "U-Boot DRAM base address"
	default 0x0
	help
	  The DRAM address where the U-Boot image
	  will be loaded if XIP is not supported

config ASPEED_KERNEL_FIT_SPI_BASE
	hex "Kernel FIT SPI base address"
	default 0x0
	help
	  The base address of the kernel FIT image in
	  the memory mapped SPI space

config ASPEED_KERNEL_FIT_SPI_SIZE
	hex "Kernel FIT SPI size in bytes"
	default 0x0
	help
	  The size in bytes of the kernel FIT image in
	  the memory mapped SPI space

config ASPEED_KERNEL_FIT_MMC_BASE
	hex "Kernel FIT eMMC base block #"
	default 0x0
	help
	  The base block number of the kernel FIT
	  image in the eMMC device

config ASPEED_KERNEL_FIT_MMC_SIZE
	hex "Kernel FIT eMMC size in blocks"
	default 0x0
	help
	  The size in block count of the kernel FIT
	  image in the eMMC device

config ASPEED_KERNEL_FIT_DRAM_BASE
	hex "Kernel FIT DRAM base address"
	default 0x0
	help
	  The DRAM address where the Kernel FIT image
	  will be loaded if XIP is not supported

endif

source "arch/arm/mach-aspeed/ast2400/Kconfig"
source "arch/arm/mach-aspeed/ast2500/Kconfig"
source "arch/arm/mach-aspeed/ast2600/Kconfig"

endif
```

## arch/arm/mach-aspeed/ast2400/Kconfig
```kconfig
if ASPEED_AST2400

config SYS_CPU
	default "arm926"

choice
	prompt "AST2400 target select"
	depends on ASPEED_AST2400
	default TARGET_EVB_AST2400

config TARGET_EVB_AST2400
	bool "EVB-AST2400"
	help
	  Evb-AST2400 is Aspeed evaluation board for AST2400 chip.
	  It has 512M of RAM, 32M of SPI flash, two Ethernet ports,
	  4 Serial ports, 4 USB ports, VGA port, PCIe, SD card slot,
	  20 pin JTAG, pinouts for 14 I2Cs, 3 SPIs and eSPI, 8 PWMs.
endchoice

source "board/aspeed/evb_ast2400/Kconfig"

endif
```

## arch/arm/mach-aspeed/ast2500/Kconfig
```kconfig
if ASPEED_AST2500

config SYS_CPU
	default "arm1176"

choice
	prompt "AST2500 target select"
	depends on ASPEED_AST2500
	default TARGET_EVB_AST2500

config TARGET_EVB_AST2500
	bool "EVB-AST2500"
	select ASPEED_GENERIC_BOARD
	help
	  Evb-AST2500 is Aspeed evaluation board for AST2500 chip.
	  It has 512M of RAM, 32M of SPI flash, two Ethernet ports,
	  4 Serial ports, 4 USB ports, VGA port, PCIe, SD card slot,
	  20 pin JTAG, pinouts for 14 I2Cs, 3 SPIs and eSPI, 8 PWMs.

config TARGET_FBY3
	select ASPEED_GEN_5
	bool "Facebook FBY3"

endchoice

source "board/aspeed/evb_ast2500/Kconfig"
source "board/fb-obmc/Kconfig"

endif
```

## arch/arm/mach-aspeed/ast2600/Kconfig
```kconfig
if ASPEED_AST2600

config SYS_CPU
	default "armv7"

choice
	prompt "AST2600 board select"
	depends on ASPEED_AST2600
	default TARGET_EVB_AST2600A0

config TARGET_EVB_AST2600A0
	bool "EVB-AST2600A0"
	depends on ASPEED_AST2600
	help
	  EVB-AST2600 is Aspeed evaluation board for AST2600 chip.
	  It has 512M of RAM, 32M of SPI flash, two Ethernet ports,
	  4 Serial ports, 4 USB ports, VGA port, PCIe, SD card slot,
	  20 pin JTAG, pinouts for 14 I2Cs, 3 SPIs and eSPI, 8 PWMs.

config TARGET_EVB_AST2600A1
	bool "EVB-AST2600A1"
	depends on ASPEED_AST2600
	help
	  EVB-AST2600A1 is based on A0 with ECO changes

config TARGET_NCSI_AST2600A0
	bool "NCSI-AST2600A0"
	depends on ASPEED_AST2600
	help
	  NCSI-AST2600 is Aspeed EVB board for AST2600 chip with NC-SI 
	  daughtercard. This is mainly for internal development. Note that
	  most implementation is co-code with EVB-AST2600.	  

config TARGET_NCSI_AST2600A1
	bool "NCSI-AST2600A1"
	depends on ASPEED_AST2600
	help
	  NCSI-AST2600A1 is based on A0 with ECO changes

config TARGET_FPGA_AST2600
	bool "FPGA-AST2600"
	depends on ASPEED_AST2600
	help
	  FPGA-AST2600 is Aspeed FPGA board for AST2600 chip.
	  This is mainly for internal development. Note that
	  most implementation is co-code with EVB-AST2600.

config TARGET_FACEBOOK_CLOUDRIPPER
	bool "FACEBOOK-CLOUDRIPPER"
	depends on ASPEED_AST2600
	help
	  FACEBOOK-CLOUDRIPPER is BMC board with AST2600 chip.

config TARGET_FACEBOOK_FUJI
	bool "FACEBOOK-FUJI"
	depends on ASPEED_AST2600
	help
	  FACEBOOK-FUJI is BMC board with AST2600 chip.

config TARGET_SLT_AST2600
	bool "SLT-AST2600"
	depends on ASPEED_AST2600
	help
	  SLT-AST2600 is Aspeed SLT board for AST2600 chip.

config TARGET_FACEBOOK_GRANDCANYON
	bool "FACEBOOK-GRANDCANYON"
	depends on ASPEED_AST2600
	help
	  FACEBOOK-GRANDCANYON is BMC board with AST2620 chip.
endchoice

source "board/aspeed/evb_ast2600a0/Kconfig"
source "board/aspeed/evb_ast2600a1/Kconfig"
source "board/aspeed/ncsi_ast2600a0/Kconfig"
source "board/aspeed/ncsi_ast2600a1/Kconfig"
source "board/aspeed/fpga_ast2600/Kconfig"
source "board/aspeed/slt_ast2600/Kconfig"
source "board/aspeed/facebook_cloudripper/Kconfig"
source "board/aspeed/facebook_fuji/Kconfig"
source "board/aspeed/facebook_grandcanyon/Kconfig"

endif
```

## board/aspeed/ast-g4/Kconfig
```kconfig
if TARGET_AST_G4

config SYS_ARCH
	default "arm"

config SYS_CPU
	default "arm926ejs"

config SYS_BOARD
	default "ast-g4"

config SYS_VENDOR
	default "aspeed"

config SYS_SOC
	default "aspeed"

endif
```

## board/aspeed/ast-g5/Kconfig
```kconfig
if ASPEED_GEN_5
config SYS_BOARD
	string "board name"
	default "ast-g5"

config SYS_VENDOR
	string "board vendor"
	default "aspeed"


config SYS_TEXT_BASE
	default 0x20015000 if ASPEED_RECOVERY_BUILD && (FBOBMC_IMG_LAYOUT_VER = 0)
	default 0x28084000 if !ASPEED_RECOVERY_BUILD && (FBOBMC_IMG_LAYOUT_VER = 0)
	default 0x20040000 if ASPEED_RECOVERY_BUILD && (FBOBMC_IMG_LAYOUT_VER = 1)
	default 0x28104000 if !ASPEED_RECOVERY_BUILD && (FBOBMC_IMG_LAYOUT_VER = 1)

config SYS_CONFIG_NAME
	string "board configure name"
	default ""
endif
```

## board/aspeed/ast2400/Kconfig
```kconfig
if TARGET_AST2400

config SYS_BOARD
	default "ast2400"

config SYS_VENDOR
	default "aspeed"

config SYS_SOC
	default "aspeed"

config SYS_CONFIG_NAME
	default "ast2400"

endif
```

## board/aspeed/ast2600_intel/Kconfig
```kconfig
if TARGET_AST2600_INTEL

config SYS_BOARD
	default "ast2600_intel"

config SYS_VENDOR
	default "aspeed"

config SYS_CONFIG_NAME
	string "board configuration name"
	default "ast2600_intel"

endif
```

## board/aspeed/cisco_churchillmono/Kconfig
```kconfig
if TARGET_CISCO_CHURCHILLMONO

config SYS_BOARD
	default "cisco_churchillmono"

config SYS_VENDOR
	default "aspeed"

config SYS_CONFIG_NAME
	string "board configuration name"
	default "cisco_churchillmono"

endif
```

## board/aspeed/evb_ast2500/Kconfig
```kconfig
if TARGET_EVB_AST2500

config SYS_TEXT_BASE
	default 0x00000000

config SYS_BOARD
	default "evb_ast2500"

config SYS_VENDOR
	default "aspeed"

config SYS_CONFIG_NAME
	string "board configuration name"
	default "evb_ast2500"

endif
```

## board/aspeed/evb_ast2600a0/Kconfig
```kconfig
if TARGET_EVB_AST2600A0

config SYS_BOARD
	default "evb_ast2600a0"

config SYS_VENDOR
	default "aspeed"

config SYS_CONFIG_NAME
	string "board configuration name"
	default "evb_ast2600a0"

endif
```

## board/aspeed/evb_ast2600a1/Kconfig
```kconfig
if TARGET_EVB_AST2600A1

config SYS_BOARD
	default "evb_ast2600a1"

config SYS_VENDOR
	default "aspeed"

config SYS_CONFIG_NAME
	string "board configuration name"
	default "evb_ast2600a1"

endif
```

## board/aspeed/facebook_cloudripper/Kconfig
```kconfig
if TARGET_FACEBOOK_CLOUDRIPPER

config SYS_BOARD
	default "facebook_cloudripper"

config SYS_VENDOR
	default "aspeed"

config SYS_CONFIG_NAME
	string "board configuration name"
	default "facebook_cloudripper"

endif
```

## board/aspeed/facebook_elbert/Kconfig
```kconfig
if TARGET_FACEBOOK_ELBERT

config SYS_BOARD
	default "facebook_elbert"

config SYS_VENDOR
	default "aspeed"

config SYS_CONFIG_NAME
	string "board configuration name"
	default "facebook_elbert"

config ABR_BOOT
    bool "enable/disable abr boot flag"
	default "n"
endif
```

## board/aspeed/facebook_fbdarwin/Kconfig
```kconfig
if TARGET_FACEBOOK_FBDARWIN

config SYS_BOARD
	default "facebook_fbdarwin"

config SYS_VENDOR
	default "aspeed"

config SYS_CONFIG_NAME
	string "board configuration name"
	default "facebook_fbdarwin"
endif
```

## board/aspeed/facebook_fby35/Kconfig
```kconfig
if TARGET_FACEBOOK_FBY35

config SYS_BOARD
	default "facebook_fby35"

config SYS_VENDOR
	default "aspeed"

config SYS_CONFIG_NAME
	string "board configuration name"
	default "facebook_fby35"

endif
```

## board/aspeed/facebook_fuji/Kconfig
```kconfig
if TARGET_FACEBOOK_FUJI

config SYS_BOARD
	default "facebook_fuji"

config SYS_VENDOR
	default "aspeed"

config SYS_CONFIG_NAME
	string "board configuration name"
	default "facebook_fuji"

endif
```

## board/aspeed/facebook_grandcanyon/Kconfig
```kconfig
if TARGET_FACEBOOK_GRANDCANYON

config SYS_BOARD
	default "facebook_grandcanyon"

config SYS_VENDOR
	default "aspeed"

config SYS_CONFIG_NAME
	string "board configuration name"
	default "facebook_grandcanyon"

endif
```

## board/aspeed/facebook_netlakemtp/Kconfig
```kconfig
if TARGET_FACEBOOK_NETLAKEMTP

config SYS_BOARD
	default "facebook_netlakemtp"

config SYS_VENDOR
	default "aspeed"

config SYS_CONFIG_NAME
	string "board configuration name"
	default "facebook_netlakemtp"

endif
```

## board/aspeed/fpga_ast2600/Kconfig
```kconfig
if TARGET_FPGA_AST2600

config SYS_BOARD
	default "fpga_ast2600"

config SYS_VENDOR
	default "aspeed"

config SYS_CONFIG_NAME
	string "board configuration name"
	default "fpga_ast2600"

endif
```

## board/aspeed/ncsi_ast2600a0/Kconfig
```kconfig
if TARGET_NCSI_AST2600A0

config SYS_BOARD
	default "ncsi_ast2600a0"

config SYS_VENDOR
	default "aspeed"

config SYS_CONFIG_NAME
	string "board configuration name"
	default "ncsi_ast2600a0"

endif
```

## board/aspeed/slt_ast2600/Kconfig
```kconfig
if TARGET_SLT_AST2600

config SYS_TEXT_BASE
	default 0x00000000

config SYS_BOARD
	default "slt_ast2600"

config SYS_VENDOR
	default "aspeed"

config SYS_CONFIG_NAME
	string "board configuration name"
	default "slt_ast2600"

endif
```

## board/aspeed/witherspoon-bmc/Kconfig
```kconfig
if TARGET_WITHERSPOON_BMC

config SYS_CPU
	default "arm1176"

config SYS_BOARD
	default "witherspoon-bmc"

config SYS_VENDOR
	default "aspeed"

config SYS_SOC
	default "aspeed"

config SYS_CONFIG_NAME
	default "witherspoon-bmc"

endif
```
