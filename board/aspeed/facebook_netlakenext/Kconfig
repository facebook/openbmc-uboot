## board/aspeed/facebook_netlakenext/Kconfig
```kconfig
if TARGET_FACEBOOK_NETLAKENEXT

config SYS_BOARD
	default "facebook_netlakenext"

config SYS_VENDOR
	default "aspeed"

config SYS_CONFIG_NAME
	string "board configuration name"
	default "facebook_netlakenext"

endif
```
