## configs/fby2_defconfig
```kconfig
CONFIG_ARM=y
CONFIG_TARGET_FBY2=y
CONFIG_SYS_NS16550=y
CONFIG_ASPEED_NET_PHY=y
CONFIG_ASPEED_SPI_DMA=y

CONFIG_DEFAULT_DEVICE_TREE="aspeed-g5-fby2-tpm"
CONFIG_CMD_IMI=y
CONFIG_OF_LIBFDT=y
CONFIG_OF_CONTROL=y
CONFIG_OF_EMBED=y
CONFIG_OF_SEPARATE=y
CONFIG_FIT=y
CONFIG_FIT_VERBOSE=n
CONFIG_FIT_SIGNATURE=y
CONFIG_DM=y
CONFIG_DM_I2C=y
CONFIG_SYS_I2C_AST=y
CONFIG_CMD_I2C=y
CONFIG_TPM=y
CONFIG_CMD_TPM=y

# SPL (ROM) feature configuration
CONFIG_SPL=y
CONFIG_SPL_FIT=y
CONFIG_SPL_TINY_FIT=y
CONFIG_SPL_LOAD_FIT=y
CONFIG_SPL_DM=y
CONFIG_SPL_OF_CONTROL=y
CONFIG_SPL_OF_LIBFDT=y
CONFIG_SPL_OF_TRANSLATE=y
CONFIG_SPL_FIT_SIGNATURE=y

# Emulators should use CONFIG_TPM_ATMEL_TWI
# CONFIG_TPM_ATMEL_TWI=y
CONFIG_TPM_TIS_INFINEON=y
CONFIG_ASPEED_TPM=y

# Leave this commented (build-step feature)
# CONFIG_ASPEED_RECOVERY_BUILD=y

# Disabled commands (save space)
CONFIG_CMD_IMLS=n
CONFIG_CMD_FDT=n
CONFIG_CMD_ELF=n
CONFIG_CMD_XIMG=n
CONFIG_CMD_NET=n
CONFIG_EFI_LOADER=n
CONFIG_CMD_FPGA=n
CONFIG_CMD_SETEXPR=n
# CONFIG_CMD_FLASH is not set
```

## configs/fbyosemite_defconfig
```kconfig
CONFIG_ARM=y
CONFIG_ASPEED=y
CONFIG_TARGET_AST2400=y
CONFIG_TARGET_FBYOSEMITE=y
CONFIG_SYS_PROMPT="FB-Yosemite> "
```

## configs/fpga-ast2600_defconfig
```kconfig
CONFIG_ARM=y
CONFIG_SYS_DCACHE_OFF=y
CONFIG_ARCH_ASPEED=y
CONFIG_SYS_TEXT_BASE=0x0
CONFIG_ASPEED_AST2600=y
CONFIG_TARGET_FPGA_AST2600=y
CONFIG_SYS_MALLOC_F_LEN=0x2000
CONFIG_ARMV7_BOOT_SEC_DEFAULT=y
CONFIG_NR_DRAM_BANKS=1
CONFIG_FIT=y
CONFIG_USE_BOOTARGS=y
CONFIG_BOOTARGS="console=ttyS4,115200n8 root=/dev/ram rw"
CONFIG_USE_BOOTCOMMAND=y
CONFIG_BOOTCOMMAND="bootm 20100000"
CONFIG_PRE_CONSOLE_BUFFER=y
CONFIG_PRE_CON_BUF_ADDR=0x10000000
CONFIG_DISPLAY_BOARDINFO_LATE=y
# CONFIG_AUTO_COMPLETE is not set
CONFIG_SYS_PROMPT="ast# "
CONFIG_CMD_CLK=y
CONFIG_CMD_GPIO=y
CONFIG_CMD_I2C=y
CONFIG_CMD_MMC=y
CONFIG_CMD_SF=y
CONFIG_CMD_DHCP=y
CONFIG_CMD_MII=y
CONFIG_CMD_PING=y
# CONFIG_CMD_DRAMTEST is not set
CONFIG_DEFAULT_DEVICE_TREE="ast2600-fpga"
CONFIG_ENV_IS_IN_SPI_FLASH=y
CONFIG_USE_ENV_SPI_BUS=y
CONFIG_ENV_SPI_BUS=0
CONFIG_USE_ENV_SPI_CS=y
CONFIG_ENV_SPI_CS=0
CONFIG_USE_ENV_SPI_MAX_HZ=y
CONFIG_ENV_SPI_MAX_HZ=100000000
CONFIG_NET_RANDOM_ETHADDR=y
CONFIG_REGMAP=y
CONFIG_SYSCON=y
CONFIG_CLK=y
# CONFIG_ASPEED_SPI_DMA is not set
CONFIG_FPGA_ASPEED=y
CONFIG_DM_GPIO=y
CONFIG_ASPEED_GPIO=y
CONFIG_DM_I2C=y
CONFIG_SYS_I2C_ASPEED=y
CONFIG_MISC=y
CONFIG_DM_MMC=y
CONFIG_MMC_TRACE=y
CONFIG_MMC_SDHCI=y
CONFIG_MMC_SDHCI_ASPEED=y
CONFIG_DM_SPI_FLASH=y
CONFIG_SPI_FLASH=y
CONFIG_SPI_FLASH_MACRONIX=y
CONFIG_SPI_FLASH_SPANSION=y
CONFIG_SPI_FLASH_WINBOND=y
CONFIG_PHY_BROADCOM=y
CONFIG_PHY_REALTEK=y
CONFIG_DM_ETH=y
CONFIG_FTGMAC100=y
CONFIG_MDIO=y
CONFIG_PHY=y
CONFIG_PINCTRL=y
CONFIG_RAM=y
CONFIG_DM_SERIAL=y
CONFIG_SYS_NS16550=y
CONFIG_SPI=y
CONFIG_DM_SPI=y
CONFIG_SYSRESET=y
CONFIG_WDT=y
```

## configs/wedge100_defconfig
```kconfig
CONFIG_ARM=y
CONFIG_ASPEED=y
CONFIG_TARGET_AST2400=y
CONFIG_TARGET_WEDGE100=y
CONFIG_SYS_PROMPT="Wedge100> "
```

## configs/wedge_defconfig
```kconfig
CONFIG_ARM=y
CONFIG_ASPEED=y
CONFIG_TARGET_AST2400=y
CONFIG_TARGET_WEDGE=y
CONFIG_SYS_PROMPT="Wedge> "
```

## drivers/crypto/Kconfig
```kconfig
menu "Hardware crypto devices"

config ASPEED_HACE
	bool "ASPEED Hash and Crypto Engine"
	depends on ASPEED_AST2600
	imply SHA_HW_ACCEL
	imply SHA_PROG_HW_ACCEL
	imply CMD_HASH
	help
	 Select this option to enable a driver for using the SHA engine in
	 the ASPEED BMC SoCs.

	 Enabling this allows the use of SHA operations in hardware without requiring the
	 SHA software implementations, saving code size.

config ASPEED_ACRY
	bool "ASPEED ECC/RSA Engine"
	depends on ASPEED_AST2600
	help
	 Select this option to enable a driver for using the ECC/RSA engine in
	 the ASPEED BMC SoCs.

	 Enabling this allows the use of ECC/RSA operations in hardware without requiring the
	 software implementations, saving code size.

source drivers/crypto/fsl/Kconfig

endmenu
```

## drivers/net/mdio/Kconfig
```kconfig
#
# MDIO infrastructure and drivers
#

menu "MDIO Support"

config MDIO
       bool "Enable MDIO (Management Data Input/Output) drivers"
       depends on DM
       help
         Enable driver model for MDIO access.
         Drivers provide methods to management data
         Input/Output.
         MDIO uclass provides interfaces to get mdio
         udevice or mii bus from its child phy node or
         an ethernet udevice which the phy belongs to.

endmenu
```

## drivers/pinctrl/aspeed/Kconfig
```kconfig
config ASPEED_AST2400_PINCTRL
  bool "Aspeed AST2400 pin control driver"
  depends on DM && PINCTRL_GENERIC && ASPEED_AST2400
  default y
  help
    Support pin multiplexing control on Aspeed ast2500 SoC. The driver uses
        Generic Pinctrl framework and is compatible with the Linux driver,
        i.e. it uses the same device tree configuration.

config ASPEED_AST2500_PINCTRL
  bool "Aspeed AST2500 pin control driver"
  depends on DM && PINCTRL_GENERIC && ASPEED_AST2500
  default y
  help
    Support pin multiplexing control on Aspeed ast2500 SoC. The driver uses
        Generic Pinctrl framework and is compatible with the Linux driver,
        i.e. it uses the same device tree configuration.

config ASPEED_AST2600_PINCTRL
  bool "Aspeed AST2600 pin control driver"
  depends on DM && PINCTRL_GENERIC && ASPEED_AST2600
  default y
  help
    Support pin multiplexing control on Aspeed ast2600 SoC. The driver uses
        Generic Pinctrl framework and is compatible with the Linux driver,
        i.e. it uses the same device tree configuration.
```

## drivers/ram/aspeed/Kconfig
```kconfig
choice
	prompt "DDR4 target data rate"
	default ASPEED_DDR4_1600

config ASPEED_DDR4_400
        bool "DDR4 targets at 400Mbps"
        depends on DM && OF_CONTROL && ARCH_ASPEED
        select RAM
        select SPL_RAM if SPL
        help
                select DDR4 target data rate at 400M

config ASPEED_DDR4_800
        bool "DDR4 targets at 800Mbps"
        depends on DM && OF_CONTROL && ARCH_ASPEED
        select RAM
        select SPL_RAM if SPL
        help
                select DDR4 target data rate at 800M

config ASPEED_DDR4_1600
        bool "DDR4 targets at 1600Mbps"
        depends on DM && OF_CONTROL && ARCH_ASPEED
        select RAM
        select SPL_RAM if SPL
        help
                select DDR4 target data rate at 1600M
endchoice

config ASPEED_DDR4_DUALX8
        bool "dual X8 DDR4 die"
        depends on DM && OF_CONTROL && ARCH_ASPEED
        select RAM
        select SPL_RAM if SPL
        default n
        help
                select dual X8 DDR4 die

config ASPEED_PALLADIUM
	bool "aspeed palladium RAM model"
	select RAM
        select SPL_RAM if SPL
	default n
	help
	  Say Y here to enable the Aspeed Palladium driver

	  This provides configurations specific for Aspeed Palladium SDRAM
	  model

config ASPEED_ECC
        bool "aspeed SDRAM error correcting code"
        depends on DM && OF_CONTROL && ARCH_ASPEED
        select RAM
        select SPL_RAM if SPL
        default n
        help
                enable SDRAM ECC function

config ASPEED_VIDEO_SIZE
	int "Video memory reserved size"
	depends on ASPEED_ECC
	default 40
	help
		reserved size for Video engine. The unit is in Megabytes.

config ASPEED_CRT_SIZE
	int "CRT memory reserved size"
	depends on ASPEED_ECC
	default 8
	help
		reserved size for CRT engine. The unit is in Megabytes.
```

## drivers/reset/aspeed/Kconfig
```kconfig
config RESET_AST2400
        bool "Reset controller driver for ASPEED AST2400 SoCs"
        depends on DM_RESET && WDT_ASPEED && ASPEED_AST2400
        default y if ARCH_ASPEED
        help
          Support for reset controller on ASPEED SoC. This controller uses
          watchdog to reset different peripherals and thus only supports
          resets that are supported by watchdog. The main limitation though
          is that some reset signals, like I2C or MISC reset multiple devices.

config RESET_AST2500
        bool "Reset controller driver for ASPEED AST2500 SoCs"
        depends on DM_RESET && WDT_ASPEED && ASPEED_AST2500
        default y if ARCH_ASPEED
        help
          Support for reset controller on ASPEED SoC. This controller uses
          watchdog to reset different peripherals and thus only supports
          resets that are supported by watchdog. The main limitation though
          is that some reset signals, like I2C or MISC reset multiple devices.

config RESET_AST2600
        bool "Reset controller driver for ASPEED AST2600 SoCs"
        depends on DM_RESET && WDT_ASPEED && ASPEED_AST2600
        default y if ARCH_ASPEED
        help
          Support for reset controller on ASPEED SoC. This controller uses
          watchdog to reset different peripherals and thus only supports
          resets that are supported by watchdog. The main limitation though
          is that some reset signals, like I2C or MISC reset multiple devices.
```

## lib/rsa/Kconfig
```kconfig
config RSA
	bool "Use RSA Library"
	select RSA_ASPEED_EXP if ARCH_ASPEED && ASPEED_ACRY
	select RSA_FREESCALE_EXP if FSL_CAAM && !ARCH_MX7 && !ARCH_MX6 && !ARCH_MX5
	select RSA_SOFTWARE_EXP if !RSA_FREESCALE_EXP && !RSA_ASPEED_EXP
	help
	  RSA support. This enables the RSA algorithm used for FIT image
	  verification in U-Boot.
	  See doc/uImage.FIT/signature.txt for more details.
	  The Modular Exponentiation algorithm in RSA is implemented using
	  driver model. So CONFIG_DM needs to be enabled by default for this
	  library to function.
	  The signing part is build into mkimage regardless of this
	  option. The software based modular exponentiation is built into
	  mkimage irrespective of this option.

if RSA

config SPL_RSA
	bool "Use RSA Library within SPL"

config RSA_SOFTWARE_EXP
	bool "Enable driver for RSA Modular Exponentiation in software"
	depends on DM
	help
	  Enables driver for modular exponentiation in software. This is a RSA
	  algorithm used in FIT image verification. It required RSA Key as
	  input.
	  See doc/uImage.FIT/signature.txt for more details.

config RSA_FREESCALE_EXP
	bool "Enable RSA Modular Exponentiation with FSL crypto accelerator"
	depends on DM && FSL_CAAM && !ARCH_MX7 && !ARCH_MX6 && !ARCH_MX5
	help
	Enables driver for RSA modular exponentiation using Freescale cryptographic
	accelerator - CAAM.

config RSA_ASPEED_EXP
	bool "Enable RSA Modular Exponentiation with ASPEED crypto accelerator"
	depends on DM && ARCH_ASPEED && ASPEED_ACRY
	help
	Enables driver for RSA modular exponentiation using ASPEED RSA/ECC
	accelerator - ARCY

endif
```
