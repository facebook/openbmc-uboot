## board/fb-obmc/ast/Kconfig
```kconfig
if TARGET_FB_AST_GEN_5 || TARGET_FB_AST_GEN_6
config SYS_BOARD
	string "board name"
	default "ast"

config SYS_VENDOR
	string "board vendor"
	default "fb-obmc"

config SYS_CONFIG_NAME
	string "board configure name"
	default ""
endif
```

## cmd/aspeed/Kconfig
```kconfig
menu "ASPEED Test commands"
depends on ARCH_ASPEED

config CMD_NETTEST
	bool "ASPEED Ethernet loopback test"
	default n

config CMD_DRAMTEST
	bool "ASPEED DRAM controller stress test"
	default y

config CMD_PECITEST
	bool "ASPEED PECI controller test"
	default y

config CMD_PLLTEST
	bool "ASPEED PLL test"
	default n

config CMD_DPTEST
	bool "ASPEED DP controller CTS"
	default n
endmenu
```

## configs/ast_g4_phy_defconfig
```kconfig
CONFIG_ARM=y
CONFIG_TARGET_AST_G4=y
CONFIG_ASPEED_NET_PHY=y
CONFIG_SYS_PROMPT="ast# "
CONFIG_CMD_DHCP=y
CONFIG_CMD_PING=y
CONFIG_SPI_FLASH=y
CONFIG_SYS_NS16550=y
```

## configs/ast_g5_defconfig
```kconfig
CONFIG_ARM=y
CONFIG_TARGET_AST_G5=y
CONFIG_SPI_FLASH=y
CONFIG_SYS_NS16550=y
CONFIG_SYS_PROMPT="ast# "
CONFIG_CMD_SAVEENV=y
CONFIG_CMD_FLASH=y
CONFIG_CMD_PING=y
CONFIG_CMD_DHCP=y
```

## configs/evb-ast2500-spl_defconfig
```kconfig
CONFIG_ARM=y
CONFIG_SYS_CONFIG_NAME="evb_ast2500_spl"
CONFIG_SPL_LDSCRIPT="arch/$(ARCH)/mach-aspeed/ast2500/u-boot-spl.lds"
CONFIG_ARCH_ASPEED=y
CONFIG_SYS_TEXT_BASE=0x10000
CONFIG_SPL_LIBCOMMON_SUPPORT=y
CONFIG_SPL_LIBGENERIC_SUPPORT=y
CONFIG_SYS_MALLOC_F_LEN=0x2000
CONFIG_SPL_SERIAL_SUPPORT=y
CONFIG_SPL_DRIVERS_MISC_SUPPORT=y
CONFIG_SPL=y
CONFIG_NR_DRAM_BANKS=1
CONFIG_FIT=y
CONFIG_SPL_FIT=y
CONFIG_SPL_FIT_PRINT=y
CONFIG_USE_BOOTARGS=y
CONFIG_BOOTARGS="console=ttyS4,115200n8 root=/dev/ram rw"
CONFIG_USE_BOOTCOMMAND=y
CONFIG_BOOTCOMMAND="bootm 20100000"
CONFIG_PRE_CONSOLE_BUFFER=y
CONFIG_PRE_CON_BUF_ADDR=0x1e720000
CONFIG_SYS_CONSOLE_ENV_OVERWRITE=y
CONFIG_SPL_SYS_MALLOC_SIMPLE=y
CONFIG_SPL_SEPARATE_BSS=y
CONFIG_SPL_RAM_SUPPORT=y
CONFIG_SPL_RAM_DEVICE=y
CONFIG_SPL_WATCHDOG_SUPPORT=y
CONFIG_HUSH_PARSER=y
# CONFIG_AUTO_COMPLETE is not set
CONFIG_SYS_PROMPT="ast# "
CONFIG_CMD_MEMTEST=y
CONFIG_SYS_ALT_MEMTEST=y
CONFIG_CMD_CLK=y
CONFIG_CMD_GPIO=y
CONFIG_CMD_I2C=y
CONFIG_CMD_MMC=y
CONFIG_CMD_SF=y
CONFIG_CMD_DHCP=y
CONFIG_CMD_MII=y
CONFIG_CMD_PING=y
CONFIG_SPL_OF_CONTROL=y
CONFIG_DEFAULT_DEVICE_TREE="ast2500-evb"
CONFIG_ENV_IS_IN_SPI_FLASH=y
CONFIG_USE_ENV_SPI_BUS=y
CONFIG_ENV_SPI_BUS=0
CONFIG_USE_ENV_SPI_CS=y
CONFIG_ENV_SPI_CS=0
CONFIG_USE_ENV_SPI_MAX_HZ=y
CONFIG_ENV_SPI_MAX_HZ=100000000
CONFIG_NET_RANDOM_ETHADDR=y
CONFIG_SPL_DM=y
CONFIG_REGMAP=y
CONFIG_CLK=y
CONFIG_SPL_CLK=y
CONFIG_DM_GPIO=y
CONFIG_ASPEED_GPIO=y
CONFIG_DM_I2C=y
CONFIG_SYS_I2C_ASPEED=y
CONFIG_MISC=y
CONFIG_DM_MMC=y
# CONFIG_MMC_HW_PARTITIONING is not set
CONFIG_MMC_SDHCI=y
CONFIG_MMC_SDHCI_ASPEED=y
CONFIG_DM_SPI_FLASH=y
CONFIG_SPI_FLASH=y
CONFIG_SPI_FLASH_MACRONIX=y
CONFIG_SPI_FLASH_SPANSION=y
CONFIG_SPI_FLASH_WINBOND=y
CONFIG_PHY_REALTEK=y
CONFIG_DM_ETH=y
CONFIG_PHY_GIGE=y
CONFIG_FTGMAC100=y
CONFIG_PHY=y
CONFIG_PINCTRL=y
CONFIG_RAM=y
CONFIG_SPL_RAM=y
CONFIG_DM_SERIAL=y
CONFIG_SYS_NS16550=y
CONFIG_SPI=y
CONFIG_DM_SPI=y
CONFIG_SYSRESET=y
CONFIG_TIMER=y
CONFIG_SPL_TIMER=y
CONFIG_WDT=y
```

## configs/evb-ast2500_defconfig
```kconfig
CONFIG_ARM=y
CONFIG_ARCH_ASPEED=y
CONFIG_SYS_TEXT_BASE=0x0
CONFIG_SYS_MALLOC_F_LEN=0x2000
CONFIG_NR_DRAM_BANKS=1
CONFIG_FIT=y
CONFIG_USE_BOOTARGS=y
CONFIG_BOOTARGS="console=ttyS4,115200n8 root=/dev/ram rw"
CONFIG_USE_BOOTCOMMAND=y
CONFIG_BOOTCOMMAND="bootm 20100000"
CONFIG_PRE_CONSOLE_BUFFER=y
CONFIG_PRE_CON_BUF_ADDR=0x1e720000
CONFIG_SYS_CONSOLE_ENV_OVERWRITE=y
CONFIG_HUSH_PARSER=y
# CONFIG_AUTO_COMPLETE is not set
CONFIG_SYS_PROMPT="ast# "
CONFIG_CMD_MEMTEST=y
CONFIG_SYS_ALT_MEMTEST=y
CONFIG_CMD_CLK=y
CONFIG_CMD_GPIO=y
CONFIG_CMD_I2C=y
CONFIG_CMD_MMC=y
CONFIG_CMD_SF=y
CONFIG_CMD_DHCP=y
CONFIG_CMD_MII=y
CONFIG_CMD_PING=y
CONFIG_DEFAULT_DEVICE_TREE="ast2500-evb"
CONFIG_ENV_IS_IN_SPI_FLASH=y
CONFIG_USE_ENV_SPI_BUS=y
CONFIG_ENV_SPI_BUS=0
CONFIG_USE_ENV_SPI_CS=y
CONFIG_ENV_SPI_CS=0
CONFIG_USE_ENV_SPI_MAX_HZ=y
CONFIG_ENV_SPI_MAX_HZ=100000000
CONFIG_NET_RANDOM_ETHADDR=y
CONFIG_REGMAP=y
CONFIG_CLK=y
CONFIG_DM_GPIO=y
CONFIG_ASPEED_GPIO=y
CONFIG_DM_I2C=y
CONFIG_SYS_I2C_ASPEED=y
CONFIG_MISC=y
CONFIG_DM_MMC=y
# CONFIG_MMC_HW_PARTITIONING is not set
CONFIG_MMC_SDHCI=y
CONFIG_MMC_SDHCI_ASPEED=y
CONFIG_DM_SPI_FLASH=y
CONFIG_SPI_FLASH=y
CONFIG_SPI_FLASH_MACRONIX=y
CONFIG_SPI_FLASH_SPANSION=y
CONFIG_SPI_FLASH_WINBOND=y
CONFIG_PHY_REALTEK=y
CONFIG_DM_ETH=y
CONFIG_PHY_GIGE=y
CONFIG_FTGMAC100=y
CONFIG_PHY=y
CONFIG_PINCTRL=y
CONFIG_RAM=y
CONFIG_DM_SERIAL=y
CONFIG_SYS_NS16550=y
CONFIG_SPI=y
CONFIG_DM_SPI=y
CONFIG_SYSRESET=y
CONFIG_TIMER=y
CONFIG_WDT=y
```

## configs/evb-ast2600a1-cot_defconfig
```kconfig
CONFIG_ARM=y
CONFIG_SYS_CONFIG_NAME="evb_ast2600a1_spl"
CONFIG_SYS_DCACHE_OFF=y
CONFIG_SPL_LDSCRIPT="arch/$(ARCH)/mach-aspeed/ast2600/u-boot-spl.lds"
CONFIG_ARCH_ASPEED=y
CONFIG_SYS_TEXT_BASE=0x10000
CONFIG_ASPEED_AST2600=y
CONFIG_SECURE_BOOT=y
CONFIG_TARGET_EVB_AST2600A1=y
CONFIG_SPL_LIBCOMMON_SUPPORT=y
CONFIG_SPL_LIBGENERIC_SUPPORT=y
CONFIG_SYS_MALLOC_F_LEN=0x800
CONFIG_SPL_MMC_SUPPORT=y
CONFIG_SPL_SERIAL_SUPPORT=y
CONFIG_SPL_DRIVERS_MISC_SUPPORT=y
CONFIG_SPL=y
CONFIG_ARMV7_BOOT_SEC_DEFAULT=y
CONFIG_NR_DRAM_BANKS=1
CONFIG_FIT=y
CONFIG_SPL_FIT=y
CONFIG_SPL_FIT_PRINT=y
CONFIG_USE_BOOTARGS=y
CONFIG_BOOTARGS="console=ttyS4,115200n8 root=/dev/ram rw"
CONFIG_USE_BOOTCOMMAND=y
CONFIG_BOOTCOMMAND="bootm 20100000"
CONFIG_SYS_CONSOLE_ENV_OVERWRITE=y
CONFIG_DISPLAY_BOARDINFO_LATE=y
CONFIG_ARCH_EARLY_INIT_R=y
CONFIG_SPL_SEPARATE_BSS=y
CONFIG_SYS_MMCSD_RAW_MODE_U_BOOT_USE_SECTOR=y
CONFIG_SYS_MMCSD_RAW_MODE_U_BOOT_SECTOR=0x0
CONFIG_SYS_MMCSD_RAW_MODE_U_BOOT_USE_PARTITION=y
CONFIG_SPL_DM_RESET=y
CONFIG_SPL_RAM_SUPPORT=y
CONFIG_SPL_RAM_DEVICE=y
CONFIG_SPL_WATCHDOG_SUPPORT=y
CONFIG_SPL_YMODEM_SUPPORT=y
CONFIG_HUSH_PARSER=y
# CONFIG_AUTO_COMPLETE is not set
CONFIG_SYS_PROMPT="ast# "
CONFIG_CMD_MEMTEST=y
CONFIG_SYS_ALT_MEMTEST=y
CONFIG_CMD_CLK=y
CONFIG_CMD_GPIO=y
CONFIG_CMD_I2C=y
CONFIG_CMD_MMC=y
CONFIG_CMD_PART=y
CONFIG_CMD_PCI=y
CONFIG_CMD_SF=y
CONFIG_CMD_USB=y
CONFIG_CMD_DHCP=y
CONFIG_CMD_MII=y
CONFIG_CMD_PING=y
CONFIG_CMD_EXT2=y
CONFIG_CMD_EXT4=y
CONFIG_CMD_EXT4_WRITE=y
CONFIG_CMD_FAT=y
CONFIG_CMD_FS_GENERIC=y
CONFIG_CMD_MTDPARTS=y
CONFIG_SPL_OF_CONTROL=y
CONFIG_DEFAULT_DEVICE_TREE="ast2600a1-evb"
CONFIG_ENV_IS_IN_SPI_FLASH=y
CONFIG_USE_ENV_SPI_BUS=y
CONFIG_ENV_SPI_BUS=0
CONFIG_USE_ENV_SPI_CS=y
CONFIG_ENV_SPI_CS=0
CONFIG_USE_ENV_SPI_MAX_HZ=y
CONFIG_ENV_SPI_MAX_HZ=100000000
CONFIG_NET_RANDOM_ETHADDR=y
CONFIG_SPL_DM=y
CONFIG_REGMAP=y
CONFIG_SYSCON=y
CONFIG_CLK=y
CONFIG_SPL_CLK=y
CONFIG_DM_GPIO=y
CONFIG_ASPEED_GPIO=y
CONFIG_DM_I2C=y
CONFIG_SYS_I2C_ASPEED=y
CONFIG_MISC=y
CONFIG_ASPEED_AHBC=y
CONFIG_ASPEED_H2X=y
CONFIG_DM_MMC=y
CONFIG_SPL_MMC_TINY=y
CONFIG_MMC_SDHCI=y
CONFIG_MMC_SDHCI_ASPEED=y
CONFIG_DM_SPI_FLASH=y
CONFIG_SPI_FLASH=y
CONFIG_SPI_FLASH_GIGADEVICE=y
CONFIG_SPI_FLASH_MACRONIX=y
CONFIG_SPI_FLASH_SPANSION=y
CONFIG_SPI_FLASH_STMICRO=y
CONFIG_SPI_FLASH_WINBOND=y
CONFIG_PHY_BROADCOM=y
CONFIG_PHY_REALTEK=y
CONFIG_DM_ETH=y
CONFIG_PHY_GIGE=y
CONFIG_FTGMAC100=y
CONFIG_MDIO=y
CONFIG_PCI=y
CONFIG_DM_PCI=y
CONFIG_PCIE_ASPEED=y
CONFIG_PHY=y
CONFIG_PINCTRL=y
CONFIG_RAM=y
CONFIG_SPL_RAM=y
CONFIG_DM_SERIAL=y
CONFIG_SYS_NS16550=y
CONFIG_SPI=y
CONFIG_DM_SPI=y
CONFIG_SYSRESET=y
CONFIG_TEE=y
CONFIG_USB=y
CONFIG_DM_USB=y
CONFIG_USB_EHCI_HCD=y
CONFIG_USB_STORAGE=y
CONFIG_WDT=y
```

## configs/facebook-cloudripper_defconfig
```kconfig
CONFIG_ARM=y
CONFIG_ARCH_ASPEED=y
CONFIG_SYS_TEXT_BASE=0x0
CONFIG_ASPEED_AST2600=y
CONFIG_TARGET_FACEBOOK_CLOUDRIPPER=y
CONFIG_SYS_MALLOC_F_LEN=0x2000
CONFIG_ARMV7_BOOT_SEC_DEFAULT=y
CONFIG_NR_DRAM_BANKS=1
CONFIG_FIT=y
CONFIG_PRE_CONSOLE_BUFFER=y
CONFIG_PRE_CON_BUF_ADDR=0x10000000
CONFIG_DISPLAY_BOARDINFO_LATE=y
CONFIG_ARCH_EARLY_INIT_R=y
CONFIG_SYS_PROMPT="cloudripper# "
CONFIG_CMD_GPIO=y
CONFIG_CMD_SF=y
CONFIG_CMD_DHCP=y
CONFIG_CMD_PING=y
CONFIG_ENV_IS_IN_SPI_FLASH=y
CONFIG_USE_ENV_SPI_BUS=y
CONFIG_ENV_SPI_BUS=0
CONFIG_USE_ENV_SPI_CS=y
CONFIG_ENV_SPI_CS=0
CONFIG_USE_ENV_SPI_MAX_HZ=y
CONFIG_ENV_SPI_MAX_HZ=100000000
CONFIG_NET_RANDOM_ETHADDR=y
CONFIG_CLK=y
CONFIG_DM_GPIO=y
CONFIG_ASPEED_GPIO=y
CONFIG_DM_I2C=y
CONFIG_SYS_I2C_ASPEED=y
CONFIG_MISC=y
CONFIG_ASPEED_AHBC=y
CONFIG_DM_MMC=y
CONFIG_MMC_SDHCI=y
CONFIG_MMC_SDHCI_ASPEED=y
CONFIG_DM_SPI_FLASH=y
CONFIG_SPI_FLASH=y
CONFIG_SPI_FLASH_MACRONIX=y
CONFIG_SPI_FLASH_STMICRO=y
CONFIG_SPI_FLASH_WINBOND=y
CONFIG_PHY_BROADCOM=y
CONFIG_PHY_REALTEK=y
CONFIG_DM_ETH=y
CONFIG_FTGMAC100=y
CONFIG_MDIO=y
CONFIG_PHY=y
CONFIG_PINCTRL=y
CONFIG_RAM=y
CONFIG_DM_SERIAL=y
CONFIG_SYS_NS16550=y
CONFIG_SPI=y
CONFIG_DM_SPI=y
CONFIG_SYSRESET=y
CONFIG_WDT=y

#
# Board specific config.
#
CONFIG_USE_BOOTARGS=y
CONFIG_BOOTARGS="console=ttyS0,9600n8 root=/dev/ram rw vmalloc=384M"
CONFIG_USE_BOOTCOMMAND=y
CONFIG_BOOTCOMMAND="bootm 20100000"
CONFIG_BAUDRATE=9600
CONFIG_DEFAULT_DEVICE_TREE="aspeed-bmc-facebook-cloudripper"
```

## configs/fbep_defconfig
```kconfig
# Target
CONFIG_TARGET_FBEP=y
CONFIG_DEFAULT_DEVICE_TREE="fbep"

# ARCH choices
CONFIG_ARM=y
CONFIG_ARCH_ASPEED=y
CONFIG_ASPEED_AST2500=y

# temp
CONFIG_ARCH_AST2500=y


# common configuration
CONFIG_DM_RESET=y
CONFIG_BAUDRATE=57600
CONFIG_NR_DRAM_BANKS=1
CONFIG_SYS_NS16550=y
CONFIG_ASPEED_NET_PHY=y
CONFIG_CMD_IMI=y
CONFIG_OF_LIBFDT=y
CONFIG_OF_CONTROL=y
CONFIG_OF_EMBED=y
CONFIG_OF_SEPARATE=y
CONFIG_FIT=y
CONFIG_FIT_VERBOSE=n
CONFIG_FIT_SIGNATURE=y
CONFIG_DM=y
CONFIG_DM_I2C=y
CONFIG_CMD_I2C=y
CONFIG_TPM=y
CONFIG_CMD_TPM=y
CONFIG_TIMER=y
CONFIG_MISC=y
CONFIG_SPI=y
CONFIG_DM_SPI=y
CONFIG_SPI_FLASH=y
CONFIG_DM_SPI_FLASH=y
# CONFIG_SPI_FLASH_MTD=y
CONFIG_SPI_FLASH_MACRONIX=y
CONFIG_SPI_FLASH_WINBOND=y
CONFIG_CMD_SF=y

# SPL (ROM) feature configuration
CONFIG_SPL=y
CONFIG_SPL_FIT=y
CONFIG_SPL_TINY_FIT=y
CONFIG_SPL_LOAD_FIT=y
CONFIG_SPL_DM=y
CONFIG_SPL_OF_CONTROL=y
CONFIG_SPL_OF_LIBFDT=y
CONFIG_SPL_OF_TRANSLATE=y
CONFIG_SPL_FIT_SIGNATURE=y
CONFIG_SPL_WATCHDOG_SUPPORT=y
CONFIG_SPL_DRIVERS_MISC_SUPPORT=y
CONFIG_SPL_TIMER=y
CONFIG_SPL_CLK=y

# Emulators should use CONFIG_TPM_ATMEL_TWI
# CONFIG_TPM_ATMEL_TWI=y
CONFIG_TPM_TIS_INFINEON=y
CONFIG_ASPEED_TPM=y

# Leave this commented (build-step feature)
# CONFIG_ASPEED_RECOVERY_BUILD=y

# Disabled commands (save space)
CONFIG_CMD_IMLS=n
CONFIG_CMD_FDT=n
CONFIG_CMD_ELF=n
CONFIG_CMD_XIMG=n
CONFIG_CMD_NET=n
CONFIG_EFI_LOADER=n
CONFIG_CMD_FPGA=n
CONFIG_CMD_SETEXPR=n
# CONFIG_CMD_FLASH is not set
# CONFIG_DISPLAY_CPUINFO is not set
CONFIG_BOOTDELAY=3

# Migrate to upstream
CONFIG_CLK=y
CONFIG_WDT=y
CONFIG_WDT_ASPEED=y
CONFIG_SYSRESET=y
CONFIG_AST_TIMER=y
CONFIG_SYS_MALLOC_F_LEN=0x800

# Enable TPM2 SPI module
# CONFIG_SPL_SPI_SUPPORT=y
# CONFIG_TPM_V2=y
# CONFIG_TPM2_TIS_SPI=y

# use SOFT_SPI
# CONFIG_DM_GPIO=y
# CONFIG_ASPEED_GPIO=y
# CONFIG_SPL_GPIO_SUPPORT=y
# CONFIG_SOFT_SPI=y

# Enable commands
# CONFIG_CMD_TPM_V2=y
```

## configs/fblightning_defconfig
```kconfig
CONFIG_ARM=y
CONFIG_TARGET_FBLIGHTNING=y
CONFIG_SYS_NS16550=y
# CONFIG_CMD_IMLS is not set
# CONFIG_CMD_FLASH is not set
# CONFIG_CMD_FPGA is not set
# CONFIG_CMD_SETEXPR is not set
CONFIG_ASPEED_NET_PHY=y
CONFIG_CMD_IMI=y
CONFIG_OF_LIBFDT=y
CONFIG_FIT=y
CONFIG_FIT_VERBOSE=y
CONFIG_FIT_SIGNATURE=y
# CONFIG_DM is not set
# CONFIG_OF_CONTROL is not set
# CONFIG_OF_EMBED is not set
```

## configs/fbobmc-ast-g4_defconfig
```kconfig
# Target
CONFIG_TARGET_FB_AST_GEN_4=y

CONFIG_SYS_TEXT_BASE=0
# ARCH choices
CONFIG_ARM=y
CONFIG_ARCH_ASPEED=y
CONFIG_ASPEED_AST2400=y




# common configuration
CONFIG_DM_RESET=y
CONFIG_BAUDRATE=57600
CONFIG_NR_DRAM_BANKS=1
CONFIG_DM_SERIAL=y
CONFIG_SYS_NS16550=y
CONFIG_ASPEED_NET_PHY=y
CONFIG_CMD_IMI=y
CONFIG_OF_LIBFDT=y
CONFIG_OF_CONTROL=y
CONFIG_OF_SEPARATE=y
CONFIG_FIT=y
CONFIG_FIT_VERBOSE=n
CONFIG_FIT_SIGNATURE=y
CONFIG_DM=y
CONFIG_DM_I2C=y
CONFIG_TIMER=y
CONFIG_MISC=y
CONFIG_SPI=y
CONFIG_DM_SPI=y
CONFIG_SPI_FLASH=y
CONFIG_DM_SPI_FLASH=y
CONFIG_SPI_FLASH_MTD=y
CONFIG_SPI_FLASH_MACRONIX=y
CONFIG_SPI_FLASH_STMICRO=y
CONFIG_SPI_FLASH_WINBOND=y
CONFIG_CMD_SF=y
CONFIG_LOG=y

# Disabled commands (save space)
CONFIG_CMD_IMLS=n
CONFIG_CMD_FDT=n
CONFIG_CMD_ELF=n
CONFIG_CMD_XIMG=n
CONFIG_CMD_NET=n
CONFIG_EFI_LOADER=n
CONFIG_CMD_FPGA=n
CONFIG_CMD_SETEXPR=n
# CONFIG_CMD_FLASH is not set
# CONFIG_DISPLAY_CPUINFO is not set
CONFIG_BOOTDELAY=3

# Migrate to upstream
CONFIG_CLK=y
CONFIG_WDT=y
CONFIG_WDT_ASPEED=y
CONFIG_SYSRESET=y
CONFIG_AST_TIMER=y
CONFIG_SYS_MALLOC_F_LEN=0x800

# Enable write default environment
CONFIG_ASPEED_WRITE_DEFAULT_ENV=y
```

## configs/fbtp_defconfig
```kconfig
CONFIG_ARM=y
CONFIG_TARGET_FBTP=y
CONFIG_SYS_NS16550=y
CONFIG_ASPEED_NET_PHY=y
# CONFIG_CMD_IMLS is not set
# CONFIG_CMD_FLASH is not set
# CONFIG_CMD_FPGA is not set
# CONFIG_CMD_SETEXPR is not set
CONFIG_EFI_LOADER=n
CONFIG_CMD_IMI=y
CONFIG_OF_LIBFDT=y
CONFIG_FIT=y
CONFIG_FIT_VERBOSE=y
CONFIG_FIT_SIGNATURE=y
CONFIG_DM=y
CONFIG_DM_I2C=y
CONFIG_SYS_I2C_AST=y
CONFIG_CMD_I2C=y
CONFIG_TPM=y
CONFIG_TPM_TIS_INFINEON=y
CONFIG_CMD_TPM=y
CONFIG_DEFAULT_DEVICE_TREE="aspeed-g5-tpm"
# CONFIG_OF_CONTROL=y
# CONFIG_OF_EMBED=y
# CONFIG_SPL=y
CONFIG_SPL_FIT=y
CONFIG_SPL_LOAD_FIT=y
CONFIG_SPL_DM=y
CONFIG_SPL_OF_CONTROL=y
CONFIG_SPL_OF_LIBFDT=y
CONFIG_SPL_FIT_SIGNATURE=y
# CONFIG_ASPEED_RECOVERY_BUILD=y
```

## configs/fbwedge400_defconfig
```kconfig
# Target
CONFIG_TARGET_FBWEDGE400=y
CONFIG_DEFAULT_DEVICE_TREE="fbwedge400"

# ARCH choices
CONFIG_ARM=y
CONFIG_ARCH_ASPEED=y
CONFIG_ASPEED_AST2500=y

# temp
CONFIG_ARCH_AST2500=y


# common configuration
CONFIG_DM_RESET=y
CONFIG_BAUDRATE=9600
CONFIG_NR_DRAM_BANKS=1
CONFIG_SYS_NS16550=y
CONFIG_ASPEED_NET_PHY=y
CONFIG_CMD_IMI=y
CONFIG_OF_LIBFDT=y
CONFIG_OF_CONTROL=y
# CONFIG_OF_EMBED=y use for debug only 
CONFIG_OF_SEPARATE=y
CONFIG_FIT=y
CONFIG_FIT_VERBOSE=y
# CONFIG_FIT_SIGNATURE=y
CONFIG_DM=y
# CONFIG_DM_I2C=y
# CONFIG_CMD_I2C=y
CONFIG_MISC=y
# CONFIG_TPM=y use for TPM support platform
# CONFIG_CMD_TPM=y
CONFIG_TIMER=y
# CONFIG_DISPLAY_CPUINFO is not set

# Migrate to upstream
CONFIG_CLK=y
CONFIG_WDT=y
CONFIG_WDT_ASPEED=y
CONFIG_SYSRESET=y
CONFIG_AST_TIMER=y
CONFIG_SPI=y
CONFIG_DM_SPI=y
CONFIG_SPI_FLASH=y
CONFIG_DM_SPI_FLASH=y
# CONFIG_SPI_FLASH_MTD=y
CONFIG_SPI_FLASH_MACRONIX=y
CONFIG_SPI_FLASH_WINBOND=y
CONFIG_CMD_SF=y

# FBoss Extra
CONFIG_SYS_TEXT_BASE=0x0
CONFIG_SPI_BOOT=y
CONFIG_HUSH_PARSER=y
CONFIG_NETCONSOLE=y
CONFIG_PHYLIB=y
CONFIG_NETDEVICES=y
CONFIG_DEBUG_UART=y
CONFIG_DEBUG_UART_BASE=0x1E783000
CONFIG_DEBUG_UART_CLOCK=24000000
CONFIG_SYS_PROMPT="Wedge400-boot=> "
```

## configs/fbwedge_defconfig
```kconfig
CONFIG_ARM=y
CONFIG_TARGET_FBWEDGE=y
CONFIG_SPI_BOOT=y
CONFIG_HUSH_PARSER=y
# CONFIG_CMD_IMLS is not set
# CONFIG_CMD_FLASH is not set
# CONFIG_CMD_FPGA is not set
# CONFIG_CMD_SETEXPR is not set
CONFIG_OF_LIBFDT=y
CONFIG_FIT=y
CONFIG_FIT_VERBOSE=y
CONFIG_FIT_SIGNATURE=y
# CONFIG_DM=y
# CONFIG_OF_CONTROL=y
# CONFIG_OF_EMBED=y
CONFIG_NETCONSOLE=y
CONFIG_PHYLIB=y
CONFIG_NETDEVICES=y
CONFIG_DEBUG_UART=y
CONFIG_DEBUG_UART_BASE=0x1E783000
CONFIG_DEBUG_UART_CLOCK=24000000
CONFIG_SYS_NS16550=y
CONFIG_SPI_FLASH=y
CONFIG_SPI_FLASH_MACRONIX=y
CONFIG_SPI_FLASH_MTD=y
CONFIG_SYS_PROMPT="Wedge-boot=> "
```
